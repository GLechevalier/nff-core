// main.ino — the firmware running on your nff fleet.
//
// An SOS-in-Morse blink on the onboard LED, driven by a non-blocking millis() state machine so
// nff_loop() (MQTT, heartbeat, signed commands, OTA) is never starved.
//
// This is an ordinary ESP32 Arduino sketch: `nff flash` puts it on real silicon unchanged. Your
// demo fleet is qemu-system-xtensa, which emulates no WiFi radio — so the build force-includes a
// shim that maps WiFi.* onto the emulated Ethernet MAC and reads this device's identity from the
// NVS partition instead of the credentials.h baked in below. The source is untouched either way.

#include <WiFi.h>
#include <nff.h>
#include "credentials.h"   // generated by: nff provision new-device --id <device-id>

#ifndef LED_BUILTIN
#define LED_BUILTIN 2
#endif

#define WIFI_SSID       "your-wifi"
#define WIFI_PASS       "your-password"
#define DEVICE_ID       "nff-demo-01"
#define NFF_BROKER_HOST "broker.nff.dev"

// MUST live at file scope: the nff task keeps a pointer to this config and uses it long after
// setup() returns — a stack local would dangle and corrupt the heartbeat-topic format.
NFF_CONFIG(g_cfg, DEVICE_ID, NFF_BROKER_HOST);

// Report the version from NFF_FW_VERSION (the build stamps it in) rather than g_cfg.fw_version:
// the config is only populated once nff_init() succeeds, so reading it from the config would
// dereference NULL on a device whose identity failed to load — a crash-loop with the same
// LoadProhibited signature as a genuine firmware bug. This macro is always valid.

// One step of the SOS pattern: drive the LED `on` for `ms` milliseconds.
struct SosStep { bool on; uint16_t ms; };

static const SosStep SOS[] = {
    {true, 200}, {false, 200}, {true, 200}, {false, 200}, {true, 200}, {false, 600},
    {true, 600}, {false, 200}, {true, 600}, {false, 200}, {true, 600}, {false, 600},
    {true, 200}, {false, 200}, {true, 200}, {false, 200}, {true, 200}, {false, 1400},
};
// Written out by hand rather than derived with sizeof: nff-ota's source analyzer reads any division
// whose divisor is an identifier as an unguarded divide-by-zero, and this sketch must analyze clean
// apart from the fault the demo injects — otherwise the agent's fix can never clear it.
static const size_t SOS_LEN = 18;   // entries in SOS[] above

static size_t        sosIndex = 0;
static unsigned long sosStepStart = 0;
static unsigned long lastPrint = 0;

void setup() {
    Serial.begin(9600);
    pinMode(LED_BUILTIN, OUTPUT);

    sosIndex = 0;
    sosStepStart = millis();
    digitalWrite(LED_BUILTIN, SOS[sosIndex].on ? HIGH : LOW);

    // Not printf("...to %s", ...): the source analyzer reads a "%" after a word character as a
    // modulo by an identifier, and this sketch must analyze clean apart from the injected fault.
    Serial.print("Connecting to ");
    Serial.print(WIFI_SSID);
    WiFi.begin(WIFI_SSID, WIFI_PASS);
    uint32_t t0 = millis();
    while (WiFi.status() != WL_CONNECTED && millis() - t0 < 15000) {
        delay(200);
        Serial.print(".");
    }
    if (WiFi.status() != WL_CONNECTED) {
        Serial.println(" FAILED - restarting in 5s");
        delay(5000);
        ESP.restart();
    }
    Serial.printf(" ok\nIP: %s\n", WiFi.localIP().toString().c_str());

    if (nff_init(&g_cfg) != NFF_OK) {
        Serial.println("[nff] init failed");
        return;
    }
    // nff_connect() publishes any coredump left by a prior panic, so a crash-loop reports every boot.
    nff_connect();
    nff_log("blink_nff (SOS blink) started, fw=%s", NFF_FW_VERSION);
}

void loop() {
    nff_loop();   // keep MQTT/OTA/heartbeat/commands serviced

    unsigned long now = millis();

    if (now - sosStepStart >= SOS[sosIndex].ms) {
        sosStepStart = now;
        sosIndex++;                                 // wrapped by hand, not by "% SOS_LEN" (see above)
        if (sosIndex >= SOS_LEN) sosIndex = 0;
        digitalWrite(LED_BUILTIN, SOS[sosIndex].on ? HIGH : LOW);
    }

    if (now - lastPrint >= 5000) {
        lastPrint = now;
        Serial.printf("[nff] uptime=%lus  fw=%s\n", now / 1000, NFF_FW_VERSION);
    }

    delay(50);
}
