// main.c — the firmware running on your nff fleet.
//
// An SOS-in-Morse blink on the onboard LED, driven from a dedicated FreeRTOS application task so the
// nff task (MQTT, heartbeat, signed commands, OTA) — pinned to the other core — is never starved.
//
// This is an ordinary ESP-IDF application: `idf.py build` puts it on real silicon unchanged. Your
// demo fleet is qemu-system-xtensa, which emulates no WiFi radio — so the build force-includes a
// shim that, AT RUNTIME, maps the esp_wifi station bring-up onto the emulated Ethernet MAC and reads
// this device's identity from the NVS partition instead of the credentials.h baked in below. On real
// silicon the same image drives the real radio (or the wired USB link) and the device's claimed
// credentials. One image, both worlds; the source is untouched either way.

#include "nff.h"
#include "nff_store.h"     // claim-store overlay for the universal (credential-less) image
#include "nff_port.h"      // nff_port_get_unique_id — device_id == operational cert CN
#include "credentials.h"   // generated by: nff provision new-device --id <device-id>

#include "esp_log.h"
#include "esp_wifi.h"
#include "esp_event.h"
#include "esp_netif.h"
#include "esp_system.h"
#include "esp_timer.h"
#include "nvs_flash.h"
#include "nvs.h"
#include "driver/gpio.h"
#include "freertos/FreeRTOS.h"
#include "freertos/task.h"
#include "freertos/event_groups.h"
#include "freertos/semphr.h"
#include <stdbool.h>
#include <string.h>
#include <stdio.h>
#include <stdarg.h>

// The wired (USB/PPPoS) fallback is compiled in UNCONDITIONALLY: one image serves both the QEMU
// demo fleet (where the shim maps esp_wifi onto the emulated Ethernet MAC, WiFi always "associates"
// and this path is never taken) and real silicon (where a device that can't associate runs its
// network over the serial cable). The QEMU-vs-real decision is made at RUNTIME, not compile time.
#include "driver/uart.h"
#include "netif/ppp/pppapi.h"
#include "netif/ppp/pppos.h"
#include "lwip/dns.h"

#define LED_GPIO        GPIO_NUM_2
#define WIFI_SSID       "your-wifi"
#define WIFI_PASS       "your-password"
#define DEVICE_ID       "nff-demo-01"
#define NFF_BROKER_HOST "broker.nff.dev"

static const char *TAG = "nff";

// MUST live at file scope AND stay non-const: the nff task keeps a pointer to this config and uses it
// long after app_main() returns, and on the QEMU demo fleet the shim's NVS loader writes the spliced
// per-device identity straight into it.
static nff_config_t g_cfg = NFF_CONFIG_INITIALIZER(DEVICE_ID, NFF_BROKER_HOST);

// Report the version from NFF_FW_VERSION (the build stamps it in) rather than g_cfg.fw_version: the
// config is only populated once nff_init() succeeds, so reading it from the config would dereference
// NULL on a device whose identity failed to load — a crash-loop with the same LoadProhibited
// signature as a genuine firmware bug. This macro is always valid.

// One step of the SOS pattern: drive the LED `on` for `ms` milliseconds.
typedef struct { bool on; uint16_t ms; } SosStep;

static const SosStep SOS[] = {
    {true, 200}, {false, 200}, {true, 200}, {false, 200}, {true, 200}, {false, 600},
    {true, 600}, {false, 200}, {true, 600}, {false, 200}, {true, 600}, {false, 600},
    {true, 200}, {false, 200}, {true, 200}, {false, 200}, {true, 200}, {false, 1400},
};
// Written out by hand rather than derived with sizeof: nff-ota's source analyzer reads any division
// whose divisor is an identifier as an unguarded divide-by-zero, and this firmware must analyze clean
// apart from the fault the demo injects — otherwise the agent's fix can never clear it.
static const size_t SOS_LEN = 18;   // entries in SOS[] above

// After an OTA the new image runs on probation; the SDK commits it (cancels rollback) once the broker
// reconnects AND this returns true. A crashing image never gets here, so it is rolled back.
static bool on_health_check(void *ctx) {
    (void)ctx;
    return esp_get_free_heap_size() >= 40000;   // enough heap left to actually run
}

static EventGroupHandle_t s_wifi_events;
#define WIFI_CONNECTED_BIT BIT0

static void wifi_event_handler(void *arg, esp_event_base_t base,
                               int32_t event_id, void *data) {
    (void)arg;
    (void)data;
    if (base == WIFI_EVENT && event_id == WIFI_EVENT_STA_START) {
        esp_wifi_connect();
    } else if (base == WIFI_EVENT && event_id == WIFI_EVENT_STA_DISCONNECTED) {
        esp_wifi_connect();   // keep retrying the association
    } else if (base == IP_EVENT && event_id == IP_EVENT_STA_GOT_IP) {
        xEventGroupSetBits(s_wifi_events, WIFI_CONNECTED_BIT);
    }
}

#define WIFI_TIMEOUT_MS  20000    // give WiFi a fair chance before switching transports

// ── Wired (USB/PPPoS) fallback ─────────────────────────────────────────────────────────────────
// A device that cannot associate with WiFi (e.g. onboarded over USB, placeholder creds) runs its
// network over the serial cable instead: a PPPoS netif on UART0, terminated by the dashboard tab
// (WiredLink), which answers DNS + NTP locally and splices TCP flows to the fleet. The nff SDK is
// netif-agnostic, so everything above this line — MQTT, heartbeat, OTA — is unchanged.

#define WIRED_BAUD       460800   // must match the dashboard WiredLink baud

static ppp_pcb      *s_ppp;
static struct netif  s_ppp_netif;
static volatile bool s_ppp_up = false;
// Serializes ALL UART0 writes (PPP frames from lwIP + console frames from the log hook) so each
// whole frame is atomic and a log line can never land mid-PPP-frame. Created in wired_connect().
static SemaphoreHandle_t s_uart0_mtx = NULL;

// lwIP hands us PPP bytes to transmit on the serial line.
static u32_t ppp_output_cb(ppp_pcb *pcb, const void *data, u32_t len, void *ctx) {
    (void)pcb;
    (void)ctx;
    if (s_uart0_mtx) xSemaphoreTake(s_uart0_mtx, portMAX_DELAY);
    int n = uart_write_bytes(UART_NUM_0, data, len);
    if (s_uart0_mtx) xSemaphoreGive(s_uart0_mtx);
    return n < 0 ? 0 : (u32_t)n;
}

// Runs on the lwIP tcpip thread, so the RAW ppp_connect (not pppapi_) is the correct re-dial here.
// A dropped link (the tab closed) just retries forever; reopening the tab re-attaches the device.
static void ppp_status_cb(ppp_pcb *pcb, int err, void *ctx) {
    (void)ctx;
    if (err == PPPERR_NONE) {
        s_ppp_up = true;
    } else {
        s_ppp_up = false;
        ppp_connect(pcb, 0);
    }
}

// Pump inbound serial bytes into the PPP input path, forever.
static void ppp_rx_task(void *arg) {
    (void)arg;
    static uint8_t buf[512];
    for (;;) {
        int n = uart_read_bytes(UART_NUM_0, buf, sizeof(buf), pdMS_TO_TICKS(20));
        if (n > 0) pppos_input_tcpip(s_ppp, buf, n);
    }
}

static void wired_connect(void) {
    // UART0 becomes a network link: a single stray log byte corrupts a PPP frame. Logging is NOT
    // silenced — console_init() routed esp_log into the log hook, which frames each line as a
    // 0xC0FF PPP frame and writes it under s_uart0_mtx, so it interleaves with PPP at the frame
    // boundary (never mid-frame). Online-ness is observed from the fleet; the console rides the link.
    uart_config_t uc = {
        .baud_rate = WIRED_BAUD,
        .data_bits = UART_DATA_8_BITS,
        .parity    = UART_PARITY_DISABLE,
        .stop_bits = UART_STOP_BITS_1,
        .flow_ctrl = UART_HW_FLOWCTRL_DISABLE,
    };
    uart_driver_install(UART_NUM_0, 4096, 4096, 0, NULL, 0);
    uart_param_config(UART_NUM_0, &uc);
    // Guard UART0 so console frames (log hook) and PPP frames (ppp_output_cb) never interleave.
    s_uart0_mtx = xSemaphoreCreateMutex();

    // esp_netif_init() already ran in wifi_connect(), so the tcpip thread exists — required
    // before any pppapi_* call, or LCP never transmits.
    s_ppp = pppapi_pppos_create(&s_ppp_netif, ppp_output_cb, ppp_status_cb, NULL);
    if (s_ppp == NULL) return;
    pppapi_set_default(s_ppp);
    pppapi_connect(s_ppp, 0);
    xTaskCreatePinnedToCore(ppp_rx_task, "ppp_rx", 4096, NULL, 12, NULL, 0);

    while (!s_ppp_up) vTaskDelay(pdMS_TO_TICKS(50));   // the tab answers as soon as it sees us

    // DNS via the WiredLink router — it also answers SNTP from the host clock.
    ip_addr_t dns;
    IP_ADDR4(&dns, 10, 0, 0, 1);
    dns_setserver(0, &dns);

    // Transport memory: this device just proved it lives on the wired link, so remember it and
    // skip the WiFi-first window on every subsequent boot (see wifi_connect). Cutting that ~20 s
    // stall matters most for the post-OTA trial: the sooner the trial image reconnects, the more
    // of the confirm window it has to hold healthy and commit instead of being rolled back.
    nvs_handle_t h;
    if (nvs_open("nffapp", NVS_READWRITE, &h) == ESP_OK) {
        nvs_set_str(h, "net_transport", "wired");
        nvs_commit(h);
        nvs_close(h);
    }
}

// True once this device has come up on the wired link at least once (persisted by wired_connect).
static bool wired_transport_remembered(void) {
    nvs_handle_t h;
    bool wired = false;
    if (nvs_open("nffapp", NVS_READONLY, &h) == ESP_OK) {
        char v[8] = {0};
        size_t n = sizeof(v);
        if (nvs_get_str(h, "net_transport", v, &n) == ESP_OK && strcmp(v, "wired") == 0) {
            wired = true;
        }
        nvs_close(h);
    }
    return wired;
}

// Associate with WIFI_SSID/WIFI_PASS and block until we have an IP; if WiFi never associates,
// fall back to the wired (USB) link. Standard ESP-IDF station bring-up otherwise.
static void wifi_connect(void) {
    // If this device already fell back to wired once, don't pay the ~20 s WiFi-first timeout
    // again — go straight to PPP. (Never set on QEMU, where the shimmed esp_wifi always
    // associates, so the demo fleet is unaffected.) wired_connect still needs the tcpip thread
    // that esp_netif_init() starts.
    if (wired_transport_remembered()) {
        esp_netif_init();
        esp_event_loop_create_default();
        wired_connect();
        return;
    }

    s_wifi_events = xEventGroupCreate();
    esp_netif_init();
    esp_event_loop_create_default();
    esp_netif_create_default_wifi_sta();

    wifi_init_config_t init_cfg = WIFI_INIT_CONFIG_DEFAULT();
    esp_wifi_init(&init_cfg);

    esp_event_handler_instance_register(WIFI_EVENT, ESP_EVENT_ANY_ID,
                                        &wifi_event_handler, NULL, NULL);
    esp_event_handler_instance_register(IP_EVENT, IP_EVENT_STA_GOT_IP,
                                        &wifi_event_handler, NULL, NULL);

    wifi_config_t wifi_cfg = { .sta = { .ssid = WIFI_SSID, .password = WIFI_PASS } };
    esp_wifi_set_mode(WIFI_MODE_STA);
    esp_wifi_set_config(WIFI_IF_STA, &wifi_cfg);
    esp_wifi_start();

    EventBits_t bits = xEventGroupWaitBits(s_wifi_events, WIFI_CONNECTED_BIT, false, true,
                                           pdMS_TO_TICKS(WIFI_TIMEOUT_MS));
    if ((bits & WIFI_CONNECTED_BIT) == 0) {
#ifdef NFF_IDF_SHIM_H
        // Universal (shimmed) image: decide at RUNTIME. On QEMU the shimmed esp_wifi always
        // associates, so a timeout normally means real silicon — but ask the identity probe, not
        // the clock, before touching UART0 (on QEMU the got-IP post may simply have raced us).
        if (nff_l2_identity_present()) {
            xEventGroupWaitBits(s_wifi_events, WIFI_CONNECTED_BIT, false, true, portMAX_DELAY);
        } else {
            ESP_LOGI(TAG, "wifi not associated - switching to the wired USB link");
            esp_wifi_stop();
            wired_connect();
            return;
        }
#else
        // Pure real-silicon build (no shim): no WiFi — run the network over the USB serial cable.
        ESP_LOGI(TAG, "wifi not associated - switching to the wired USB link");
        esp_wifi_stop();
        wired_connect();
        return;
#endif
    }
    ESP_LOGI(TAG, "network up");
}

static void app_task(void *arg) {
    (void)arg;
    gpio_reset_pin(LED_GPIO);
    gpio_set_direction(LED_GPIO, GPIO_MODE_OUTPUT);

    size_t sosIndex = 0;

    for (;;) {
        gpio_set_level(LED_GPIO, SOS[sosIndex].on ? 1 : 0);
        vTaskDelay(pdMS_TO_TICKS(SOS[sosIndex].ms));

        sosIndex++;                                 // wrapped by hand, not by "% SOS_LEN" (see above)
        if (sosIndex >= SOS_LEN) sosIndex = 0;

        if (sosIndex == 0) {
            ESP_LOGI(TAG, "uptime=%llu s  fw=%s",
                     (unsigned long long)(esp_timer_get_time() / 1000000), NFF_FW_VERSION);
        }
    }
}

// ── Wired serial console: device logs ride the PPP link ───────────────────────────────────────
// UART0 is the PPP data link, so we can't just print on it. Instead every ESP_LOG line is wrapped
// in its OWN HDLC/PPP frame with a private protocol number (0xC0FF) and written to UART0 under the
// shared lock, so it interleaves with real PPP frames only at frame boundaries. The browser
// WiredLink demultiplexes proto 0xC0FF into the dashboard Serial Monitor. No 2nd UART/adapter;
// console + network run at the same time.
#define CONSOLE_PROTO   0xC0FF
#define CONSOLE_MAXTEXT 256

// FCS-16 (CRC-16/X.25, poly 0x8408 reflected, init 0xFFFF) — byte-identical to the browser's
// hdlc.ts fcs16(). The FCS transmitted on the wire is the ones-complement, little-endian.
static uint16_t fcs16(const uint8_t *data, int len) {
    uint16_t fcs = 0xFFFF;
    for (int i = 0; i < len; i++) {
        fcs ^= data[i];
        for (int b = 0; b < 8; b++) fcs = (fcs & 1) ? (fcs >> 1) ^ 0x8408 : (fcs >> 1);
    }
    return fcs;
}

// Frame `text` as a complete 0xC0FF PPP frame and write it to UART0 atomically (under s_uart0_mtx)
// so it never lands inside a PPP IP/LCP frame. Called only from the esp_log vprintf hook.
static void console_emit(const char *text, int len) {
    if (!s_ppp_up || s_uart0_mtx == NULL || len <= 0) return;   // only once the wired link is up
    if (len > CONSOLE_MAXTEXT) len = CONSOLE_MAXTEXT;

    uint8_t body[4 + CONSOLE_MAXTEXT];
    body[0] = 0xFF; body[1] = 0x03;                    // addr, ctrl (uncompressed, per the decoder)
    body[2] = (CONSOLE_PROTO >> 8) & 0xFF;             // proto hi 0xC0 (even → 2-byte parse)
    body[3] = CONSOLE_PROTO & 0xFF;                    // proto lo 0xFF (odd → valid PPP proto)
    memcpy(body + 4, text, len);
    int blen = 4 + len;
    uint16_t fcs = fcs16(body, blen) ^ 0xFFFF;
    uint8_t tail[2] = { (uint8_t)(fcs & 0xFF), (uint8_t)((fcs >> 8) & 0xFF) };

    uint8_t out[2 * (4 + CONSOLE_MAXTEXT + 2) + 2];
    int o = 0;
    out[o++] = 0x7E;
    for (int part = 0; part < 2; part++) {
        const uint8_t *p = part == 0 ? body : tail;
        int pl = part == 0 ? blen : 2;
        for (int i = 0; i < pl; i++) {
            uint8_t c = p[i];
            if (c == 0x7E || c == 0x7D || c < 0x20) { out[o++] = 0x7D; out[o++] = c ^ 0x20; }
            else out[o++] = c;
        }
    }
    out[o++] = 0x7E;

    xSemaphoreTake(s_uart0_mtx, portMAX_DELAY);
    uart_write_bytes(UART_NUM_0, out, o);
    xSemaphoreGive(s_uart0_mtx);
}

static int console_vprintf(const char *fmt, va_list args) {
    char buf[CONSOLE_MAXTEXT];
    int n = vsnprintf(buf, sizeof(buf), fmt, args);
    if (n > 0) console_emit(buf, n < (int)sizeof(buf) ? n : (int)sizeof(buf) - 1);
    return n;
}

static void console_init(void) {
    esp_log_set_vprintf(console_vprintf);
    esp_log_level_set("*", ESP_LOG_INFO);
    // The TLS/MQTT failure reason lives on these tags (ESP_LOGE is captured regardless of level).
    esp_log_level_set("esp-tls", ESP_LOG_DEBUG);
    esp_log_level_set("esp-tls-mbedtls", ESP_LOG_DEBUG);
    esp_log_level_set("mqtt_client", ESP_LOG_DEBUG);
    esp_log_level_set("transport_base", ESP_LOG_DEBUG);
}

// Fleet root CA (CN=nff-fleet-ca), self-signed; it signs the broker server cert (CN=nff-fleet-server)
// that this device dials. Baked in because the universal image ships a STUB credentials.h (no CA)
// and a claim store that may carry no CA (op_ca empty) — without a CA, esp-tls refuses to set up TLS
// ("No server verification option set" → ESP_ERR_MBEDTLS_SSL_SETUP_FAILED) and the OTA can't connect
// to commit. The root CA is public and fleet-wide, so compiling it in is safe. DER, from
// nff-fleet /data/certs/ca.crt.
static const uint8_t FLEET_ROOT_CA_DER[] = {
    0x30, 0x82, 0x01, 0x73, 0x30, 0x82, 0x01, 0x18, 0xa0, 0x03, 0x02, 0x01,
    0x02, 0x02, 0x14, 0x06, 0x3e, 0xdd, 0x04, 0x37, 0x86, 0xa6, 0x6f, 0x6a,
    0xb1, 0xf0, 0xc1, 0x36, 0x05, 0x0e, 0x6d, 0x01, 0xdc, 0xb4, 0x1f, 0x30,
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    0x73, 0x7e, 0x84,
};

void app_main(void) {
    console_init();   // route esp_log into the 0xC0FF-over-PPP console (UART0 is the PPP link)
    // nff_log() bypasses esp_log and printf()s raw to UART0 (stdout) — that would corrupt PPP, so
    // silence it; the diagnostic-critical logs (esp-mqtt/esp-tls) flow through the esp_log hook.
    nff_log_set_quiet(true);
    nvs_flash_init();
    wifi_connect();

    if (nff_init(&g_cfg) != NFF_OK) {
        ESP_LOGE(TAG, "nff_init failed");
        return;
    }

    // The universal image builds with NFF_BOOTSTRAP_ENABLED=0, so nff_init never overlays the
    // operational creds this device persisted at claim rollover (op_cert/op_key/op_chain in NVS) —
    // on real silicon it would dial the broker with NO client cert and the stub device_id, and the
    // broker drops the MQTT CONNECT (transport_read EOF, seen live on 1.0.15). Overlay the claim
    // store here instead. QEMU is untouched: its NVS identity loader already filled client_cert,
    // and the guard skips a cfg that carries creds. device_id must become the hardware id — it is
    // the operational cert's CN and the broker's ACL requires client_id == CN.
    if (!g_cfg.client_cert || g_cfg.client_cert_len == 0) {
        static nff_config_t s_claimed;         // blobs stay malloc'd for the life of the device
        static char         s_hwid[24];
        if (nff_store_is_claimed() && nff_store_load(&g_cfg, &s_claimed) == NFF_OK) {
            nff_port_get_unique_id(s_hwid, sizeof(s_hwid));
            s_claimed.device_id = s_hwid;
            g_cfg = s_claimed;                 // nff keeps a pointer to g_cfg; update it in place
            ESP_LOGI(TAG, "claim store creds loaded (id=%s, chain=%u B)",
                     s_hwid, (unsigned)g_cfg.client_cert_len);
        } else {
            ESP_LOGW(TAG, "no claim store creds — MQTT will connect without a client cert");
        }
    }

    // The claim store predates op_ca provisioning on this fleet (op_ca is empty), so ca_cert is
    // still NULL after the overlay. Without a CA, esp-tls aborts setup ("No server verification
    // option set", 0x8017). Supply the baked fleet root CA as a fallback so the broker can be
    // verified. The port reads cfg->ca_cert lazily at connect, so setting it here (before
    // nff_connect) takes effect.
    if (!g_cfg.ca_cert || g_cfg.ca_cert_len == 0) {
        g_cfg.ca_cert     = FLEET_ROOT_CA_DER;
        g_cfg.ca_cert_len = sizeof(FLEET_ROOT_CA_DER);
        ESP_LOGW(TAG, "claim store had no CA — using baked fleet root CA (%u B)",
                 (unsigned)sizeof(FLEET_ROOT_CA_DER));
    }

    // Gate the OTA commit/rollback on our own notion of healthy before connecting.
    nff_register_health_check(on_health_check, NULL);

    // nff_connect() publishes any coredump left by a prior panic, so a crash-loop reports every boot.
    nff_connect();
    // rst tells post-OTA reboots apart: 12 = SW_CPU (deliberate esp_restart, e.g. a completed
    // flip) vs 1 = POWERON (external EN pulse — e.g. the serial link resetting the chip).
    ESP_LOGI(TAG, "=== wired console up (0xC0FF over PPP), fw=%s rst=%d — nff services starting ===",
             NFF_FW_VERSION, (int)esp_reset_reason());

    // nff services MQTT/heartbeat/commands/OTA on its own task (Core 0); the app runs on Core 1.
    nff_start_task();
    xTaskCreate(app_task, "app", 4096, NULL, 5, NULL);
}
