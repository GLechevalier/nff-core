/**
 * main.c — Stage-0 networking spike for nff-mock Level 2 (virtual ESP32 in QEMU).
 *
 * THROWAWAY. This is the spike the roadmap (docs/NFF_MOCK_ROADMAP.md, Part 2) gates everything
 * downstream on. Its only job: prove that the REAL nff-sdk-c firmware, booted in
 * `qemu-system-xtensa`, can come up on the OpenCores Ethernet MAC (QEMU emulates no WiFi radio),
 * set a sane clock, complete an mTLS handshake against the real `nff-fleet` broker, get a CONNACK,
 * and publish one retained heartbeat. If this fails, the "firmware self-networks" architecture
 * must be reconsidered before any Stage-3 firmware variant is written.
 *
 * It is `examples/espidf_basic/main/main.c` with THREE deliberate divergences:
 *   1. openeth bring-up replaces WiFi  (no radio in QEMU; only the openeth NIC is emulated).
 *   2. settimeofday(boot_epoch) replaces SNTP  (QEMU has no RTC; the clock boots near 1970, so
 *      mbedTLS would reject the broker cert as MBEDTLS_X509_BADCERT_FUTURE).
 *   3. compiled-in credentials.h  (generated by: nff-fleet provision new-device).
 *
 * Build: ESP-IDF (openeth is an IDF-only API). See ../../RUNBOOK.md.
 */

#include "nff.h"
#include "credentials.h"   // generated by: nff-fleet provision new-device --id <id> --project <uuid>

#include "esp_log.h"
#include "esp_event.h"
#include "esp_netif.h"
#include "esp_eth.h"
#include "esp_mac.h"
#include "nvs.h"
#include "nvs_flash.h"
#include "freertos/FreeRTOS.h"
#include "freertos/task.h"
#include "freertos/event_groups.h"
#include <sys/time.h>
#include <string.h>

static const char *TAG = "spike";

// ---- Configuration -------------------------------------------------------
//
// The device id MUST equal the cert CN (the broker's auth plugin enforces client_id == CN), so it
// is fixed to whatever you provisioned. NFF_BROKER_HOST is the FIXED GUEST IP the SLIRP guestfwd
// rule forwards host-side to the real `nff-fleet:8883` (see nff_mock_l2/qemu.py build_qemu_argv).

#define DEVICE_ID        "spike-01"
#define NFF_BROKER_HOST  "10.13.0.10"     // guestfwd → ncat nff-fleet 8883

// Fallback boot epoch baked in at build time when NVS has none. Override with
// -DNFF_SPIKE_BOOT_EPOCH=$(date +%s) so the broker cert's validity window is satisfied.
#ifndef NFF_SPIKE_BOOT_EPOCH
#  define NFF_SPIKE_BOOT_EPOCH 1750000000   // 2025-06-15; bump if certs are issued later
#endif

// ---- nff config (reads credentials.h automatically) ----------------------

static const nff_config_t g_cfg = NFF_CONFIG_INITIALIZER(DEVICE_ID, NFF_BROKER_HOST);

// ---- openeth bring-up (replaces WiFi) ------------------------------------

static EventGroupHandle_t s_eth_events;
#define ETH_GOT_IP_BIT BIT0

static void eth_event_handler(void *arg, esp_event_base_t base,
                              int32_t event_id, void *data) {
    if (base == IP_EVENT && event_id == IP_EVENT_ETH_GOT_IP) {
        ip_event_got_ip_t *ev = (ip_event_got_ip_t *)data;
        ESP_LOGI(TAG, "openeth GOT_IP: " IPSTR, IP2STR(&ev->ip_info.ip));
        xEventGroupSetBits(s_eth_events, ETH_GOT_IP_BIT);
    } else if (base == ETH_EVENT && event_id == ETHERNET_EVENT_CONNECTED) {
        ESP_LOGI(TAG, "openeth link up");
    }
}

static void openeth_connect(void) {
    s_eth_events = xEventGroupCreate();

    ESP_ERROR_CHECK(esp_netif_init());
    ESP_ERROR_CHECK(esp_event_loop_create_default());

    esp_netif_config_t netif_cfg = ESP_NETIF_DEFAULT_ETH();
    esp_netif_t *eth_netif = esp_netif_new(&netif_cfg);

    // QEMU's esp32 machine emulates the OpenCores Ethernet MAC (openeth). The IDF MAC driver is
    // selected with CONFIG_ETH_USE_OPENETH=y; pair it with the DP83848 PHY model. This mirrors
    // IDF's own QEMU path (examples/common_components/protocol_examples_common/eth_connect.c):
    // defaults + a short autoneg timeout, which QEMU's openeth needs so PHY bring-up doesn't stall.
    eth_mac_config_t mac_cfg = ETH_MAC_DEFAULT_CONFIG();
    eth_phy_config_t phy_cfg = ETH_PHY_DEFAULT_CONFIG();
    phy_cfg.autonego_timeout_ms = 100;

    esp_eth_mac_t *mac = esp_eth_mac_new_openeth(&mac_cfg);
    esp_eth_phy_t *phy = esp_eth_phy_new_dp83848(&phy_cfg);

    esp_eth_config_t eth_cfg = ETH_DEFAULT_CONFIG(mac, phy);
    esp_eth_handle_t eth_handle = NULL;
    ESP_ERROR_CHECK(esp_eth_driver_install(&eth_cfg, &eth_handle));

    // A locally-administered MAC so the emulated link has a stable address.
    uint8_t mac_addr[6] = {0x02, 0x00, 0x00, 0x12, 0x34, 0x56};
    esp_eth_ioctl(eth_handle, ETH_CMD_S_MAC_ADDR, mac_addr);

    ESP_ERROR_CHECK(esp_netif_attach(eth_netif, esp_eth_new_netif_glue(eth_handle)));
    ESP_ERROR_CHECK(esp_event_handler_register(IP_EVENT, IP_EVENT_ETH_GOT_IP,
                                               &eth_event_handler, NULL));
    ESP_ERROR_CHECK(esp_event_handler_register(ETH_EVENT, ESP_EVENT_ANY_ID,
                                               &eth_event_handler, NULL));
    ESP_ERROR_CHECK(esp_eth_start(eth_handle));

    // lwIP routes sockets/TLS/MQTT over the DEFAULT netif — make it openeth so all of
    // WiFiClientSecure/PubSubClient/HTTPClient traffic flows through the emulated NIC unchanged.
    ESP_ERROR_CHECK(esp_netif_set_default_netif(eth_netif));

    ESP_LOGI(TAG, "waiting for openeth DHCP lease...");
    xEventGroupWaitBits(s_eth_events, ETH_GOT_IP_BIT, false, true, portMAX_DELAY);
    ESP_LOGI(TAG, "openeth connected");
}

// ---- boot epoch (replaces SNTP) ------------------------------------------
//
// THE most important divergence. A fresh QEMU boot has no RTC, so the clock sits near epoch 0 and
// every real cert looks "not yet valid" → the mTLS handshake fails with MBEDTLS_X509_BADCERT_FUTURE.
// We read an injected epoch from NVS (namespace "nff", key "boot_epoch", written by the supervisor's
// credentials.py) and settimeofday() it; SNTP is never called.

static void set_clock_from_nvs(void) {
    int64_t epoch = NFF_SPIKE_BOOT_EPOCH;

    nvs_handle_t h;
    if (nvs_open("nff", NVS_READONLY, &h) == ESP_OK) {
        char buf[24] = {0};
        size_t len = sizeof(buf);
        if (nvs_get_str(h, "boot_epoch", buf, &len) == ESP_OK) {
            int64_t v = strtoll(buf, NULL, 10);
            if (v > 1000000000LL) epoch = v;   // sanity floor (2001-09-09)
        }
        nvs_close(h);
    }

    struct timeval tv = { .tv_sec = (time_t)epoch, .tv_usec = 0 };
    settimeofday(&tv, NULL);
    ESP_LOGI(TAG, "clock set to boot_epoch=%lld (no SNTP)", (long long)epoch);
}

// ---- OTA health check (kept; harmless for the spike) ---------------------

static bool on_health_check(void *ctx) {
    (void)ctx;
    return esp_get_free_heap_size() >= 40000;
}

// ---- Entry point ---------------------------------------------------------

void app_main(void) {
    nvs_flash_init();

    openeth_connect();      // 1. network up via Ethernet (no WiFi radio in QEMU)
    set_clock_from_nvs();   // 2. sane clock BEFORE any TLS handshake

    if (nff_init(&g_cfg) != NFF_OK) {
        ESP_LOGE(TAG, "nff_init failed");
        return;
    }
    nff_register_health_check(on_health_check, NULL);

    // 3. mTLS to the broker, retained heartbeat, command subscribe — all REAL.
    if (nff_connect() == NFF_OK) {
        // The connect path (nff_mqtt.c) already published the retained heartbeat via
        // nff_heartbeat_on_connect(). Emit a UART marker the supervisor scans for; the broker-side
        // watcher (spike/tools/watch_heartbeat.py) is the authoritative PASS signal.
        ESP_LOGI(TAG, "SPIKE: heartbeat published");
    } else {
        ESP_LOGW(TAG, "SPIKE: nff_connect failed (will retry in nff task)");
    }
    nff_log("spike app started, fw=%s", NFF_FW_VERSION);

    nff_start_task();       // nff task on Core 0 handles reconnect/heartbeat/commands
}
