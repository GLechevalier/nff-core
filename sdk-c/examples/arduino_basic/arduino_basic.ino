/**
 * arduino_basic.ino — Minimal nff-sdk-c example for Arduino ESP32.
 *
 * Before flashing:
 *   1. Run: nff provision new-device --id my-device-01
 *      This generates credentials.h in the current directory.
 *   2. Copy credentials.h into this sketch folder.
 *   3. Update WIFI_SSID / WIFI_PASS and NFF_BROKER_HOST below.
 *   4. Flash with `nff flash sketches/arduino_basic`.
 *
 * What this sketch does:
 *   - Connects to WiFi
 *   - Initialises nff (installs panic hook, checks for crash/OTA from last boot)
 *   - Connects to the nff broker over mTLS (port 8883)
 *   - Publishes a retained heartbeat every 30 s
 *   - Responds to built-in commands: ping, reboot, ota, diag
 *   - Logs to both UART and the RTC pre-crash log buffer
 */

#include <WiFi.h>
#include <nff.h>
#include "credentials.h"    // generated by: nff provision new-device --id my-device-01

// ---- Configuration -------------------------------------------------------

#define WIFI_SSID      "YourWiFiSSID"
#define WIFI_PASS      "YourWiFiPassword"
#define DEVICE_ID      "my-device-01"
#define NFF_BROKER_HOST "nff.yourdomain.com"

// ---- nff config (reads credentials.h automatically) ----------------------

NFF_CONFIG(g_cfg, DEVICE_ID, NFF_BROKER_HOST);

// ---- Optional: register a custom command ---------------------------------

static void on_led_cmd(const char *payload, char *resp, size_t resp_len, void *ctx) {
    (void)ctx;
    // Parse the "on" field from the payload JSON (simplified example)
    bool on = strstr(payload, "\"on\":true") != NULL;
    digitalWrite(LED_BUILTIN, on ? HIGH : LOW);
    snprintf(resp, resp_len,
             "{\"type\":\"led_ack\",\"on\":%s}", on ? "true" : "false");
}

// ---- Optional but recommended: OTA health check --------------------------
//
// After an OTA the new image runs on probation. The SDK already gates commit on
// "broker reconnected + free heap above a floor + a soak window"; registering a
// health check adds YOUR application's notion of healthy. Return false until the
// app is genuinely working — a freshly-flashed image that can't read its sensor
// or whose heap is collapsing will then be rolled back automatically instead of
// committed. Must be quick and non-blocking (called every nff_loop while on trial).
static bool on_health_check(void *ctx) {
    (void)ctx;
    // Example: require the app to have a sane heap and a working sensor read.
    if (ESP.getFreeHeap() < 40000) return false;
    // bool sensor_ok = (analogRead(34) > 0);   // your real self-test here
    // if (!sensor_ok) return false;
    return true;
}

// --------------------------------------------------------------------------

void setup() {
    Serial.begin(115200);
    pinMode(LED_BUILTIN, OUTPUT);

    // Connect to WiFi first
    Serial.printf("Connecting to %s...\n", WIFI_SSID);
    WiFi.begin(WIFI_SSID, WIFI_PASS);
    uint32_t t0 = millis();
    while (WiFi.status() != WL_CONNECTED && millis() - t0 < 15000) {
        delay(500);
        Serial.print(".");
    }
    if (WiFi.status() != WL_CONNECTED) {
        Serial.println("\nWiFi failed — restarting");
        ESP.restart();
    }
    Serial.printf("\nWiFi connected, IP: %s\n", WiFi.localIP().toString().c_str());

    // Initialise nff (before WiFi or after — both work)
    if (nff_init(&g_cfg) != NFF_OK) {
        Serial.println("nff_init failed");
        return;
    }

    // Register custom commands before connecting
    nff_register_command("led", on_led_cmd, NULL);

    // Register the OTA health check before connecting — it gates whether a freshly
    // flashed image is committed or rolled back (see on_health_check above).
    nff_register_health_check(on_health_check, NULL);

    // Connect to the nff broker (blocking first attempt, retries in loop)
    nff_connect();
    nff_log("Device started, fw=%s", NFF_FW_VERSION);
}

void loop() {
    // Drive the nff state machine (reconnect, heartbeat, command dispatch)
    nff_loop();

    // Your application code here — nff_loop() returns in microseconds when idle
    delay(10);
}
