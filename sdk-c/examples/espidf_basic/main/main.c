/**
 * main.c — Minimal nff-sdk-c example for ESP-IDF.
 *
 * Place this under components/nff/ and add:
 *   idf_component_register(SRCS "main.c" REQUIRES nff esp_wifi nvs_flash)
 * in your CMakeLists.txt.
 *
 * Before building:
 *   nff provision new-device --id my-device-01
 *   # Copies credentials.h to this directory
 *
 * The application task runs on Core 1 (default). nff runs on Core 0
 * via nff_start_task(). The two cores are completely isolated.
 */

#include "nff.h"
#include "credentials.h"   // generated by: nff provision new-device --id my-device-01

#include "esp_log.h"
#include "esp_wifi.h"
#include "esp_event.h"
#include "nvs_flash.h"
#include "freertos/FreeRTOS.h"
#include "freertos/task.h"
#include "freertos/event_groups.h"
#include <string.h>

static const char *TAG = "app";

// ---- Configuration -------------------------------------------------------

#define WIFI_SSID       "YourWiFiSSID"
#define WIFI_PASS       "YourWiFiPassword"
#define DEVICE_ID       "my-device-01"
#define NFF_BROKER_HOST "nff.yourdomain.com"

// ---- nff config (reads credentials.h automatically) ----------------------

static const nff_config_t g_cfg = NFF_CONFIG_INITIALIZER(DEVICE_ID, NFF_BROKER_HOST);

// ---- WiFi helpers --------------------------------------------------------

static EventGroupHandle_t s_wifi_events;
#define WIFI_CONNECTED_BIT BIT0

static void wifi_event_handler(void *arg, esp_event_base_t base,
                                int32_t event_id, void *data) {
    if (base == WIFI_EVENT && event_id == WIFI_EVENT_STA_START) {
        esp_wifi_connect();
    } else if (base == WIFI_EVENT && event_id == WIFI_EVENT_STA_DISCONNECTED) {
        esp_wifi_connect();
    } else if (base == IP_EVENT && event_id == IP_EVENT_STA_GOT_IP) {
        xEventGroupSetBits(s_wifi_events, WIFI_CONNECTED_BIT);
    }
}

static void wifi_connect(void) {
    s_wifi_events = xEventGroupCreate();
    esp_netif_init();
    esp_event_loop_create_default();
    esp_netif_create_default_wifi_sta();

    wifi_init_config_t init_cfg = WIFI_INIT_CONFIG_DEFAULT();
    esp_wifi_init(&init_cfg);

    esp_event_handler_instance_register(WIFI_EVENT, ESP_EVENT_ANY_ID,
                                         &wifi_event_handler, NULL, NULL);
    esp_event_handler_instance_register(IP_EVENT, IP_EVENT_STA_GOT_IP,
                                         &wifi_event_handler, NULL, NULL);

    wifi_config_t wifi_cfg = { .sta = { .ssid = WIFI_SSID, .password = WIFI_PASS } };
    esp_wifi_set_mode(WIFI_MODE_STA);
    esp_wifi_set_config(WIFI_IF_STA, &wifi_cfg);
    esp_wifi_start();

    xEventGroupWaitBits(s_wifi_events, WIFI_CONNECTED_BIT, false, true, portMAX_DELAY);
    ESP_LOGI(TAG, "WiFi connected");
}

// ---- Optional: custom command handler ------------------------------------

static void on_status_cmd(const char *payload, char *resp, size_t resp_len, void *ctx) {
    (void)payload; (void)ctx;
    snprintf(resp, resp_len,
             "{\"type\":\"status_ack\",\"uptime_ms\":%lu}",
             (unsigned long)(esp_timer_get_time() / 1000));
}

// ---- Optional but recommended: OTA health check --------------------------
//
// After an OTA the new image runs on probation. The SDK already gates commit on
// "broker reconnected + free heap above a floor + a soak window"; this callback
// adds YOUR application's notion of healthy. Return false until the app is truly
// working so a bad image is rolled back automatically. Must be non-blocking.
static bool on_health_check(void *ctx) {
    (void)ctx;
    if (esp_get_free_heap_size() < 40000) return false;
    // Add your own self-test here (sensor read, peripheral init, etc.).
    return true;
}

// ---- Application task (Core 1) -------------------------------------------

static void app_task(void *arg) {
    (void)arg;
    ESP_LOGI(TAG, "App task running on Core 1");
    for (;;) {
        // Application logic here — completely isolated from Core 0 nff task
        vTaskDelay(pdMS_TO_TICKS(1000));
    }
}

// ---- Entry point ---------------------------------------------------------

void app_main(void) {
    nvs_flash_init();
    wifi_connect();

    // Init nff — installs panic hook, checks previous crash / pending OTA
    if (nff_init(&g_cfg) != NFF_OK) {
        ESP_LOGE(TAG, "nff_init failed");
        return;
    }

    // Register custom commands before connecting
    nff_register_command("status", on_status_cmd, NULL);

    // Register the OTA health check before connecting — gates OTA commit/rollback.
    nff_register_health_check(on_health_check, NULL);

    // Connect to nff broker (first attempt; nff task handles reconnects)
    nff_connect();
    nff_log("ESP-IDF app started, fw=%s", NFF_FW_VERSION);

    // Start nff task pinned to Core 0 — returns immediately
    nff_start_task();

    // Start application task on Core 1 (default affinity)
    xTaskCreate(app_task, "app", 4096, NULL, 10, NULL);
}
